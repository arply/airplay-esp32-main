## components/boards/Kconfig.projbuild
```kconfig
menu "Board Configuration"
    choice BOARD_TARGET
        prompt "Select Target Board"
        default BOARD_ARPLY_V1

        config BOARD_ARPLY_V1
            bool "ARPLY v1 (Seeed XIAO ESP32-S3, PCM5102A)"
            depends on IDF_TARGET_ESP32S3

    endchoice

    config BOARD_TARGET_PATH
        string
        default "arply-v1" if BOARD_ARPLY_V1

    menu "Pin Configuration"
        menu "LED GPIOs"
            config LED_STATUS_GPIO
                int "Status LED GPIO"
                default -1
                help
                    GPIO for status LED (single color). Set to -1 to disable.

            config LED_ERROR_GPIO
                int "Error LED GPIO"
                default -1
                help
                    GPIO for error LED. Set to -1 to disable.

            config LED_RGB_GPIO
                int "RGB LED GPIO (WS2812)"
                default -1
                help
                    GPIO for addressable RGB LED (WS2812). Set to -1 to disable.
        endmenu

        menu "I2S and S/PDIF Pin Configuration"
            config I2S_SCK_IO
                int "I2S Master Clock GPIO"
                default -1
                help
                    I2S Master (system) Clock GPIO pin to use; needed with some I2S conversion boards.
                                        
            config I2S_BCK_IO
                int "I2S Bit Clock GPIO"
                default -1
                help
                    I2S Bit Clock GPIO pin to use.

            config I2S_WS_IO
                int "I2S Word Select GPIO"
                default -1
                help
                    I2S Word Select GPIO pin to use.

            config I2S_DO_IO
                int "I2S Data Output GPIO"
                default -1
                help
                    I2S Data Output GPIO pin to use.

        endmenu

        menu "Control GPIOs"
            config MUTE_GPIO
                int "Mute GPIO"
                default -1
                help
                    GPIO used to mute DAC/amplifier. Set to -1 to disable.

            config MUTE_GPIO_LEVEL
                int "Mute GPIO Active Level"
                default 0
                help
                    Active level for mute GPIO (0=active low, 1=active high).
        endmenu

    endmenu

endmenu
```
